## sdkconfig.defaults
```kconfig
# ESP32-S3 LVGL Template - Default Configuration
#
# This file contains the minimal required configuration for this project.
# Users can override these settings by running 'idf.py menuconfig'
#

# Target Configuration
CONFIG_IDF_TARGET="esp32"

# Serial flasher config
CONFIG_ESPTOOLPY_FLASHSIZE_2MB=y
CONFIG_ESPTOOLPY_FLASHFREQ_40M=y
CONFIG_ESPTOOLPY_FLASHMODE_DIO=y

# Partition Table
CONFIG_PARTITION_TABLE_SINGLE_APP=y

# Compiler options
CONFIG_COMPILER_OPTIMIZATION_SIZE=y
CONFIG_COMPILER_OPTIMIZATION_ASSERTIONS_ENABLE=y

# FreeRTOS
CONFIG_FREERTOS_HZ=1000

# ESP System Settings
CONFIG_ESP_MAIN_TASK_STACK_SIZE=8192

# LVGL Configuration (via managed component, but set some defaults)
# Note: Most LVGL settings come from lv_conf.h and component config

# SPI Configuration
CONFIG_SPI_MASTER_ISR_IN_IRAM=y

# Log output
CONFIG_LOG_DEFAULT_LEVEL_INFO=y
CONFIG_LOG_MAXIMUM_LEVEL_VERBOSE=y

# Component config
CONFIG_FREERTOS_ENABLE_BACKWARD_COMPATIBILITY=y
```
